## config/west.yml
```yaml
manifest:
  remotes:
    - name: zmkfirmware
      url-base: https://github.com/zmkfirmware
  projects:
    - name: zmk
      remote: zmkfirmware
      revision: main
      import: app/west.yml
    - name: q11-numpad-module
      url: https://github.com/fred4500/zmk-config-template-v2
      revision: main
      path: zmk-module
  self:
    path: config
```
